## examples/getting_started/main/Kconfig.projbuild
```kconfig
menu "Getting Started Example"

    config EXAMPLE_STARTUP_SPEAKER_BEEP
        bool "Play startup speaker beep"
        default n
        help
            Enable a short startup beep to validate the speaker path.

    config EXAMPLE_USE_LVGL_MUSIC_DEMO
        bool "Start LVGL music demo UI"
        default y
        depends on LV_USE_DEMO_MUSIC
        help
            Start lv_demo_music() after display initialization.

endmenu
```

## examples/getting_started/sdkconfig.defaults
```kconfig
CONFIG_IDF_TARGET="esp32p4"
CONFIG_SECURE_BOOT=y
CONFIG_ESPTOOLPY_FLASHSIZE_16MB=y
CONFIG_PARTITION_TABLE_CUSTOM=y
CONFIG_PARTITION_TABLE_OFFSET=0xd000
CONFIG_SPIRAM=y
CONFIG_SPIRAM_SPEED_80M=y
CONFIG_FREERTOS_HZ=1000
CONFIG_LV_OS_FREERTOS=y
CONFIG_LV_DRAW_BUF_ALIGN=64
CONFIG_LV_USE_PPA=y
CONFIG_LV_USE_PPA_IMG=y
CONFIG_LV_USE_DEMO_WIDGETS=y
CONFIG_LV_USE_DEMO_MUSIC=y
CONFIG_ANA_CMPR_ISR_HANDLER_IN_IRAM=y
CONFIG_ANA_CMPR_OBJ_CACHE_SAFE=y
CONFIG_AUDIO_PLAYER_ENABLE_MP3=y
CONFIG_AUDIO_PLAYER_ENABLE_WAV=y
CONFIG_AUDIO_PLAYER_LOG_LEVEL=0
CONFIG_BSP_DISPLAY_BRIGHTNESS_LEDC_CH=1
CONFIG_BSP_ENABLE_AUDIO_PLAYER_HELPERS=y
CONFIG_BSP_ERROR_CHECK=y
CONFIG_BSP_I2C_CLK_SPEED_HZ=400000
CONFIG_BSP_I2C_FAST_MODE=y
CONFIG_BSP_I2C_NUM=1
CONFIG_BSP_I2S_NUM=1
CONFIG_BSP_LCD_COLOR_FORMAT_RGB565=y
CONFIG_BSP_LCD_DPI_BUFFER_NUMS=1
CONFIG_BSP_LCD_TYPE_1024_600=y
CONFIG_BSP_LCD_USE_DMA2D=y
CONFIG_BSP_SD_MOUNT_POINT="/sdcard"
CONFIG_BSP_SPIFFS_MAX_FILES=5
CONFIG_BSP_SPIFFS_MOUNT_POINT="/spiffs"
CONFIG_BSP_SPIFFS_PARTITION_LABEL="storage"
CONFIG_CODEC_AW88298_SUPPORT=y
CONFIG_CODEC_ES7210_SUPPORT=y
CONFIG_CODEC_ES7243E_SUPPORT=y
CONFIG_CODEC_ES7243_SUPPORT=y
CONFIG_CODEC_ES8156_SUPPORT=y
CONFIG_CODEC_ES8311_SUPPORT=y
CONFIG_CODEC_ES8374_SUPPORT=y
CONFIG_CODEC_ES8388_SUPPORT=y
CONFIG_CODEC_ES8389_SUPPORT=y
CONFIG_CODEC_TAS5805M_SUPPORT=y
CONFIG_CU_DIAGNOSTICS_COLOR_ALWAYS=y
CONFIG_ESPTOOLPY_FLASHSIZE="16MB"
CONFIG_ESPTOOLPY_NO_STUB=y
CONFIG_ESP_LCD_TOUCH_MAX_BUTTONS=1
CONFIG_ESP_LCD_TOUCH_MAX_POINTS=5
CONFIG_ESP_SLEEP_PSRAM_LEAKAGE_WORKAROUND=y
CONFIG_ESP_SPI_BUS_LOCK_ISR_FUNCS_IN_IRAM=y
CONFIG_EXAMPLE_USE_LVGL_MUSIC_DEMO=y
CONFIG_FATFS_ALLOC_PREFER_EXTRAM=y
CONFIG_FATFS_CODEPAGE=437
CONFIG_FATFS_CODEPAGE_437=y
CONFIG_FATFS_DONT_TRUST_FREE_CLUSTER_CNT=0
CONFIG_FATFS_DONT_TRUST_LAST_ALLOC=0
CONFIG_FATFS_FS_LOCK=0
CONFIG_FATFS_LFN_NONE=y
CONFIG_FATFS_LINK_LOCK=y
CONFIG_FATFS_PER_FILE_CACHE=y
CONFIG_FATFS_SECTOR_4096=y
CONFIG_FATFS_TIMEOUT_MS=10000
CONFIG_FATFS_USE_STRFUNC_NONE=y
CONFIG_FATFS_VFS_FSTAT_BLKSIZE=0
CONFIG_FATFS_VOLUME_COUNT=2
CONFIG_FREERTOS_TASK_CREATE_ALLOW_EXT_MEM=y
CONFIG_GDMA_CTRL_FUNC_IN_IRAM=y
CONFIG_GPTIMER_ISR_HANDLER_IN_IRAM=y
CONFIG_GPTIMER_OBJ_CACHE_SAFE=y
CONFIG_I2C_MASTER_ISR_HANDLER_IN_IRAM=y
CONFIG_LIBC_STDIN_LINE_ENDING_CR=y
CONFIG_LIBC_STDOUT_LINE_ENDING_CRLF=y
CONFIG_LVGL_VERSION_MAJOR=9
CONFIG_LVGL_VERSION_MINOR=5
CONFIG_LVGL_VERSION_PATCH=0
CONFIG_LV_ASSERT_HANDLER_INCLUDE="assert.h"
CONFIG_LV_ATTRIBUTE_MEM_ALIGN_SIZE=1
CONFIG_LV_BUILD_DEMOS=y
CONFIG_LV_BUILD_EXAMPLES=y
CONFIG_LV_CACHE_DEF_SIZE=0
CONFIG_LV_COLOR_DEPTH=16
CONFIG_LV_COLOR_DEPTH_16=y
CONFIG_LV_COLOR_MIX_ROUND_OFS=128
CONFIG_LV_CONF_SKIP=y
CONFIG_LV_DEF_REFR_PERIOD=33
CONFIG_LV_DPI_DEF=130
CONFIG_LV_DRAW_BUF_STRIDE_ALIGN=1
CONFIG_LV_DRAW_LAYER_MAX_MEMORY=0
CONFIG_LV_DRAW_LAYER_SIMPLE_BUF_SIZE=24576
CONFIG_LV_DRAW_SW_ASM_NONE=y
CONFIG_LV_DRAW_SW_CIRCLE_CACHE_SIZE=4
CONFIG_LV_DRAW_SW_COMPLEX=y
CONFIG_LV_DRAW_SW_DRAW_UNIT_CNT=1
CONFIG_LV_DRAW_SW_I1_LUM_THRESHOLD=127
CONFIG_LV_DRAW_SW_SHADOW_CACHE_SIZE=0
CONFIG_LV_DRAW_SW_SUPPORT_A8=y
CONFIG_LV_DRAW_SW_SUPPORT_AL88=y
CONFIG_LV_DRAW_SW_SUPPORT_ARGB8888=y
CONFIG_LV_DRAW_SW_SUPPORT_ARGB8888_PREMULTIPLIED=y
CONFIG_LV_DRAW_SW_SUPPORT_I1=y
CONFIG_LV_DRAW_SW_SUPPORT_L8=y
CONFIG_LV_DRAW_SW_SUPPORT_RGB565=y
CONFIG_LV_DRAW_SW_SUPPORT_RGB565A8=y
CONFIG_LV_DRAW_SW_SUPPORT_RGB565_SWAPPED=y
CONFIG_LV_DRAW_SW_SUPPORT_RGB888=y
CONFIG_LV_DRAW_SW_SUPPORT_XRGB8888=y
CONFIG_LV_DRAW_THREAD_PRIO=3
CONFIG_LV_DRAW_THREAD_STACK_SIZE=8192
CONFIG_LV_FONT_DEFAULT_MONTSERRAT_14=y
CONFIG_LV_FONT_MONTSERRAT_14=y
CONFIG_LV_FRIDAY_STR="Fr"
CONFIG_LV_FS_DEFAULT_DRIVER_LETTER=0
CONFIG_LV_GRADIENT_MAX_STOPS=2
CONFIG_LV_IMAGE_HEADER_CACHE_DEF_CNT=0
CONFIG_LV_LABEL_LONG_TXT_HINT=y
CONFIG_LV_LABEL_TEXT_SELECTION=y
CONFIG_LV_LABEL_WAIT_CHAR_COUNT=3
CONFIG_LV_MEM_ADR=0x0
CONFIG_LV_MEM_POOL_EXPAND_SIZE_KILOBYTES=0
CONFIG_LV_MEM_SIZE_KILOBYTES=64
CONFIG_LV_MONDAY_STR="Mo"
CONFIG_LV_PPA_BURST_LENGTH=128
CONFIG_LV_SATURDAY_STR="Sa"
CONFIG_LV_SPAN_SNIPPET_STACK_SIZE=64
CONFIG_LV_SUNDAY_STR="Su"
CONFIG_LV_TEXTAREA_DEF_PWD_SHOW_TIME=1500
CONFIG_LV_THEME_DEFAULT_GROW=y
CONFIG_LV_THEME_DEFAULT_TRANSITION_TIME=80
CONFIG_LV_THURSDAY_STR="Th"
CONFIG_LV_TUESDAY_STR="Tu"
CONFIG_LV_TXT_BREAK_CHARS=" ,.;:-_)}"
CONFIG_LV_TXT_COLOR_CMD="#"
CONFIG_LV_TXT_ENC_UTF8=y
CONFIG_LV_TXT_LINE_BREAK_LONG_LEN=0
CONFIG_LV_USE_ANIMIMG=y
CONFIG_LV_USE_ARC=y
CONFIG_LV_USE_ARCLABEL=y
CONFIG_LV_USE_ASSERT_MALLOC=y
CONFIG_LV_USE_ASSERT_NULL=y
CONFIG_LV_USE_BAR=y
CONFIG_LV_USE_BUILTIN_MALLOC=y
CONFIG_LV_USE_BUILTIN_SPRINTF=y
CONFIG_LV_USE_BUILTIN_STRING=y
CONFIG_LV_USE_BUTTON=y
CONFIG_LV_USE_BUTTONMATRIX=y
CONFIG_LV_USE_CALENDAR=y
CONFIG_LV_USE_CALENDAR_HEADER_ARROW=y
CONFIG_LV_USE_CALENDAR_HEADER_DROPDOWN=y
CONFIG_LV_USE_CANVAS=y
CONFIG_LV_USE_CHART=y
CONFIG_LV_USE_CHECKBOX=y
CONFIG_LV_USE_DRAW_SW=y
CONFIG_LV_USE_DRAW_SW_ASM=0
CONFIG_LV_USE_DROPDOWN=y
CONFIG_LV_USE_FLEX=y
CONFIG_LV_USE_FONT_PLACEHOLDER=y
CONFIG_LV_USE_FREERTOS_TASK_NOTIFY=y
CONFIG_LV_USE_GRID=y
CONFIG_LV_USE_IMAGE=y
CONFIG_LV_USE_IMAGEBUTTON=y
CONFIG_LV_USE_KEYBOARD=y
CONFIG_LV_USE_LABEL=y
CONFIG_LV_USE_LED=y
CONFIG_LV_USE_LINE=y
CONFIG_LV_USE_LIST=y
CONFIG_LV_USE_MENU=y
CONFIG_LV_USE_MSGBOX=y
CONFIG_LV_USE_OBSERVER=y
CONFIG_LV_USE_ROLLER=y
CONFIG_LV_USE_SCALE=y
CONFIG_LV_USE_SLIDER=y
CONFIG_LV_USE_SPAN=y
CONFIG_LV_USE_SPINBOX=y
CONFIG_LV_USE_SPINNER=y
CONFIG_LV_USE_SWITCH=y
CONFIG_LV_USE_TABLE=y
CONFIG_LV_USE_TABVIEW=y
CONFIG_LV_USE_TEXTAREA=y
CONFIG_LV_USE_THEME_DEFAULT=y
CONFIG_LV_USE_THEME_SIMPLE=y
CONFIG_LV_USE_TILEVIEW=y
CONFIG_LV_USE_WIN=y
CONFIG_LV_WEDNESDAY_STR="We"
CONFIG_LV_WIDGETS_HAS_DEFAULT_VALUE=y
CONFIG_MBEDTLS_FS_IO=y
CONFIG_MCPWM_ISR_HANDLER_IN_IRAM=y
CONFIG_MCPWM_OBJ_CACHE_SAFE=y
CONFIG_NEWLIB_STDIN_LINE_ENDING_CR=y
CONFIG_NEWLIB_STDOUT_LINE_ENDING_CRLF=y
CONFIG_PARLIO_OBJ_CACHE_SAFE=y
CONFIG_PARLIO_RX_ISR_HANDLER_IN_IRAM=y
CONFIG_PARLIO_TX_ISR_HANDLER_IN_IRAM=y
CONFIG_RMT_ENCODER_FUNC_IN_IRAM=y
CONFIG_RMT_OBJ_CACHE_SAFE=y
CONFIG_RMT_RX_ISR_HANDLER_IN_IRAM=y
CONFIG_RMT_TX_ISR_HANDLER_IN_IRAM=y
CONFIG_SEMIHOSTFS_MAX_MOUNT_POINTS=1
CONFIG_SPIFFS_CACHE=y
CONFIG_SPIFFS_CACHE_WR=y
CONFIG_SPIFFS_GC_MAX_RUNS=10
CONFIG_SPIFFS_MAX_PARTITIONS=3
CONFIG_SPIFFS_META_LENGTH=4
CONFIG_SPIFFS_OBJ_NAME_LEN=32
CONFIG_SPIFFS_PAGE_CHECK=y
CONFIG_SPIFFS_PAGE_SIZE=256
CONFIG_SPIFFS_USE_MAGIC=y
CONFIG_SPIFFS_USE_MAGIC_LENGTH=y
CONFIG_SPIFFS_USE_MTIME=y
CONFIG_SPIRAM_ALLOW_STACK_EXTERNAL_MEMORY=y
CONFIG_SPIRAM_BOOT_HW_INIT=y
CONFIG_SPIRAM_BOOT_INIT=y
CONFIG_SPIRAM_MALLOC_ALWAYSINTERNAL=16384
CONFIG_SPIRAM_MALLOC_RESERVE_INTERNAL=32768
CONFIG_SPIRAM_MEMTEST=y
CONFIG_SPIRAM_MODE_HEX=y
CONFIG_SPIRAM_PRE_CONFIGURE_MEMORY_PROTECTION=y
CONFIG_SPIRAM_SPEED=80
CONFIG_SPIRAM_USE_MALLOC=y
CONFIG_SPI_MASTER_ISR_IN_IRAM=y
CONFIG_SPI_SLAVE_ISR_IN_IRAM=y
CONFIG_SUPPORT_TERMIOS=y
CONFIG_SUPPRESS_SELECT_DEBUG_OUTPUT=y
CONFIG_USB_HOST_CONTROL_TRANSFER_MAX_SIZE=256
CONFIG_USB_HOST_DEBOUNCE_DELAY_MS=250
CONFIG_USB_HOST_HW_BUFFER_BIAS_BALANCED=y
CONFIG_USB_HOST_RESET_HOLD_MS=30
CONFIG_USB_HOST_RESET_RECOVERY_MS=30
CONFIG_USB_HOST_SET_ADDR_RECOVERY_MS=10
CONFIG_USB_OTG_SUPPORTED=y
CONFIG_USJ_ENABLE_USB_SERIAL_JTAG=y
CONFIG_VFS_INITIALIZE_DEV_NULL=y
CONFIG_VFS_MAX_COUNT=8
CONFIG_VFS_SEMIHOSTFS_MAX_MOUNT_POINTS=1
CONFIG_VFS_SUPPORT_DIR=y
CONFIG_VFS_SUPPORT_IO=y
CONFIG_VFS_SUPPORT_SELECT=y
CONFIG_VFS_SUPPORT_TERMIOS=y
CONFIG_VFS_SUPPRESS_SELECT_DEBUG_OUTPUT=y
CONFIG_WL_SECTOR_SIZE=4096
CONFIG_WL_SECTOR_SIZE_4096=y
```
